## techpack/xiaomi-sdm845/audio/Kconfig
```kconfig
menu "Audio Power Amplifier"
	depends on SND_SOC

config SND_SOC_TAS2559
	tristate "Texas Instruments TAS2559 speaker amplifier"
	depends on I2C

config SND_SOC_TAS2557
	tristate "Texas Instruments TAS2557 speaker amplifier"
	depends on I2C

config SND_ELLIPTIC
	tristate "Providing Interface to UPS data"
	depends on I2C

endmenu
```
