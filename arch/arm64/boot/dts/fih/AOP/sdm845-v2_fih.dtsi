#include "sdm845-fih-memmap.dtsi"
#include "sdm845-fih-apr.dtsi"
#include "sdm845-fih-ddr.dtsi"
#include "sdm845-fih-mfd.dtsi"
#include "sdm845-fih-cda.dtsi"
#include "sdm845-fih-seb.dtsi"
#include "sdm845-fih-rst.dtsi"
