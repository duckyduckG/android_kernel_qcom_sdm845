&soc {
	fih_info {
		compatible = "fih_info";
		status = "ok";
		fih-info,devmodel = "AOP";
		fih-info,baseband = "2.6G";
		fih-info,bandinfo = "G_850_900_1800_1900^W_1_2_5_8^C_0^T_34_39^L_1_2_3_4_5_7_8_12_17_20_28_34_38_39_40_41";
		fih-info,hwmodel  = "AOP";
		fih-info,simslot  = "2";
	};
};
