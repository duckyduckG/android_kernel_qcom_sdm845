#include "sdm845-fih-info_aop-pvt_gcr.dtsi"

/* Pinctrl */
#include "sdm845-pinctrl_aop-pvt.dtsi"
#include "pm845-pinctrl_aop-pvt.dtsi"
#include "pmi8998-pinctrl_aop-pvt.dtsi"
#include "pm8005-pinctrl_aop-pvt.dtsi"

#include "sdm845-platform_aop-pvt.dtsi"
#include "sdm845-pmic_aop-pvt.dtsi"

/* Battery */
#include "battery-evt1-5.dtsi"

/* Touch */
#include "touch_fts.dtsi"
#include "touch_atmel.dtsi"

/* Display */
#include "display.dtsi"

/* Haptics */
#include "haptics-dw7912-evb.dtsi"

/* ASIC Flash */
#include "asic-flash_aop-evb.dtsi"

/* NFC */
#include "nfc_nq_nci.dtsi"

/* Audio */
#include "sdm845-audio_aop-evt2.dtsi"

/* Gyro */
#include "gyro_icm40605.dtsi"

/* Hall sensor */
#include "hall-ah1902-evb.dtsi"

/* Switch */
#include "switch-ts3a5018_aop-pre-evt.dtsi"

/* Flash LED */
#include "flashled-lm3644_aop-pre-evt.dtsi"

/* LIGHT Camera */
#include "sdm845-light-camera.dtsi"

/* Fingerprint */
#include "fingerprint-gf5288-evb.dtsi"
#include "fingerprint-qbt2000-evt.dtsi"
#include "fingerprint-egis-evt.dtsi"

/* Wifi */
#include "wifi-module-evb.dtsi"

/* Proximity */
#include "alsp_cm36686.dtsi"

/* Front Camera */
#include "sdm845-front-camera.dtsi"
