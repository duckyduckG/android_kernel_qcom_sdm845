/* NOTICE:
 * Default set <status> be "disabled" in fingerprint_xxx.dtsi,
 * and set be "okay" by fp_id (fih_fp) when bootloader load device tree.
 */

&soc {
	gf5288 {
		compatible = "goodix,fingerprint";
		status = "disabled";
		interrupt-parent = <&tlmm>;
		interrupts = <0 121 0>;
		fp-gpio-reset = <&tlmm 95 0x0>;
		fp-gpio-irq = <&tlmm 121 0x0>;
		fp-gpio-enable = <&tlmm 78 0x0>;
		goodix,key-customer-define = <1>;
		avdd-supply = <&pmi8998_bob>;
	};
};
