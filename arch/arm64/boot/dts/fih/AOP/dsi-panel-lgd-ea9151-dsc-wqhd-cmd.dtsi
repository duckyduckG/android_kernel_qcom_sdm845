&mdss_mdp {
	dsi_lgd_ea9151_wqhd_dsc_cmd: qcom,mdss_dsi_lgd_ea9151_dsc_cmd {
		qcom,mdss-dsi-panel-name =
			"EA9151 cmd mode dsi LGD panel with DSC";
		qcom,mdss-dsi-panel-type = "dsi_cmd_mode";
		qcom,mdss-dsi-virtual-channel-id = <0>;
		qcom,mdss-dsi-panel-id = <2>;
		qcom,mdss-dsi-stream = <0>;
		qcom,mdss-pan-physical-width-dimension = <68>;
		qcom,mdss-pan-physical-height-dimension = <136>;
		qcom,mdss-dsi-bpp = <24>;
		qcom,mdss-dsi-color-order = "rgb_swap_rgb";
		qcom,mdss-dsi-underflow-color = <0xff>;
		qcom,mdss-dsi-border-color = <0>;
		qcom,mdss-dsi-traffic-mode = "non_burst_sync_event";
		qcom,mdss-dsi-bllp-eof-power-mode;
		qcom,mdss-dsi-tx-eot-append;
		qcom,mdss-dsi-bllp-power-mode;
		qcom,mdss-dsi-lane-0-state;
		qcom,mdss-dsi-lane-1-state;
		qcom,mdss-dsi-lane-2-state;
		qcom,mdss-dsi-lane-3-state;
		qcom,mdss-dsi-dma-trigger = "trigger_sw";
		qcom,mdss-dsi-mdp-trigger = "none";
		qcom,mdss-dsi-reset-sequence = <0 10>, <0 10>, <1 10>;
		qcom,mdss-dsi-power-off-reset-timing = <10>;
		qcom,mdss-dsi-bl-max-level = <997>;
		qcom,adjust-timer-wakeup-ms = <1>;
		qcom,mdss-dsi-te-pin-select = <1>;
		qcom,mdss-dsi-wr-mem-start = <0x2c>;
		qcom,mdss-dsi-wr-mem-continue = <0x3c>;
		qcom,mdss-dsi-te-dcs-command = <1>;
		qcom,mdss-dsi-te-check-enable;
		qcom,mdss-dsi-te-using-te-pin;
		qcom,mdss-dsi-bl-reg-swap;
		qcom,mdss-dsi-aod-independent-brightness;
		qcom,mdss-dsi-lp11-init;
		qcom,mdss-panel-on-after-pixel-out;


		qcom,mdss-dsi-panel-hdr-enabled;
		qcom,mdss-dsi-panel-hdr-color-primaries = <14500 15500 32000
				17000 15500 30000 8000 3000>;
		qcom,mdss-dsi-panel-peak-brightness = <4200000>;
		qcom,mdss-dsi-panel-blackness-level = <3230>;
		qcom,mdss-dsi-display-timings {
			timing@0{
				qcom,mdss-dsi-panel-framerate = <60>;
				qcom,mdss-dsi-panel-width = <1440>;
				qcom,mdss-dsi-panel-height = <2880>;
				qcom,mdss-dsi-h-front-porch = <144>;
				qcom,mdss-dsi-h-back-porch = <144>;
				qcom,mdss-dsi-h-pulse-width = <32>;
				qcom,mdss-dsi-h-sync-skew = <0>;
				qcom,mdss-dsi-v-back-porch = <28>;
				qcom,mdss-dsi-v-front-porch = <24>;
				qcom,mdss-dsi-v-pulse-width = <4>;
				qcom,mdss-dsi-h-left-border = <0>;
				qcom,mdss-dsi-h-right-border = <0>;
				qcom,mdss-dsi-v-top-border = <0>;
				qcom,mdss-dsi-v-bottom-border = <0>;
				qcom,mdss-dsi-panel-jitter = <0x1 0x1>;
				qcom,mdss-dsi-on-command = [
						39 01 00 00 00 00 03 7F 5A 5A
						39 01 00 00 00 00 03 F0 5A 5A
						39 01 00 00 00 00 03 F1 5A 5A
						39 01 00 00 00 00 03 F2 5A 5A
						15 01 00 00 00 00 02 02 01
						15 01 00 00 00 00 02 53 20
						39 01 00 00 00 00 06 57 60 A0 DE 60 00
						39 01 00 00 00 00 05 2A 00 00 05 9F
						39 01 00 00 00 00 05 2B 00 00 0B 3F
						15 01 00 00 00 00 02 35 00

						05 01 00 00 78 00 02 11 00
						15 01 00 00 00 00 02 B0 0F
						15 01 00 00 00 00 02 E1 C0

						39 01 00 00 0A 00 02 C3 04
//						05 01 00 00 00 00 02 29 00

					];
				qcom,mdss-dsi-off-command = [
						05 01 00 00 00 00 02 28 00
						05 01 00 00 64 00 02 10 00
					];
				qcom,mdss-dsi-lp1-command = [
						39 01 00 00 00 00 03 7F 5A 5A
						39 01 00 00 00 00 03 F0 5A 5A
						39 01 00 00 00 00 03 F1 5A 5A
						39 01 00 00 00 00 03 F2 5A 5A
						05 01 00 00 00 00 02 28 00
						15 01 00 00 00 00 02 B0 06
						39 01 00 00 00 00 05 C2 23 00 09 69
//						15 01 00 00 00 00 02 5A 00
						39 01 00 00 00 00 03 51 00 02
						15 01 00 00 00 00 02 B0 0D
						39 01 00 00 00 00 03 BF BF FC
						05 01 00 00 0A 00 02 39 00
						39 01 00 00 00 00 05 30 00 00 0B 40
						05 01 00 00 78 00 02 12 00
						05 01 00 00 00 00 02 29 00

					];
				qcom,mdss-dsi-nolp-command = [
						39 01 00 00 00 00 03 7F 5A 5A
						39 01 00 00 00 00 03 F0 5A 5A
						39 01 00 00 00 00 03 F1 5A 5A
						39 01 00 00 00 00 03 F2 5A 5A
						05 01 00 00 00 00 02 28 00
						15 01 00 00 00 00 02 B0 06
						39 01 00 00 00 00 05 C2 23 00 12 65
//						15 01 00 00 00 00 02 FA 00
						39 01 00 00 00 00 03 BF BF FC
						05 01 00 00 0A 00 02 13 00

						05 01 00 00 00 00 02 38 00
						39 01 00 00 32 00 03 51 00 03
//						05 01 00 00 00 00 02 29 00
					];
				qcom,mdss-dsi-pixel-display-on-command = [
					05 01 00 00 00 00 02 29 00
				];

				qcom,mdss-dsi-pixel-display-on-command-state = "dsi_lp_mode";

				qcom,mdss-dsi-lp1-command-state = "dsi_hs_mode";
				qcom,mdss-dsi-nolp-command-state = "dsi_hs_mode";

				qcom,mdss-dsi-on-command-state = "dsi_lp_mode";
				qcom,mdss-dsi-off-command-state = "dsi_hs_mode";
				qcom,mdss-dsi-h-sync-pulse = <0>;
				qcom,compression-mode = "dsc";
				qcom,mdss-dsc-slice-height = <720>;
				qcom,mdss-dsc-slice-width = <720>;
				qcom,mdss-dsc-slice-per-pkt = <1>;
				qcom,mdss-dsc-bit-per-component = <8>;
				qcom,mdss-dsc-bit-per-pixel = <8>;
				qcom,mdss-dsc-block-prediction-enable;
			};
		};
	};
};
