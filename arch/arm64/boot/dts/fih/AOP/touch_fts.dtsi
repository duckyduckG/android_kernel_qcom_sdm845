&qupv3_se14_i2c{

	status = "ok";
	st_fts@49 {
                status = "ok";
		compatible = "st,fts";
		reg = <0x49>;						//SAD
		interrupt-parent = <&tlmm>;
		interrupts = <125 0x00>;
		//ivdd-supply = <&pm8998_l14>;			//1.8V power regulator
                TP_LDO_1P8_EN = <&tlmm 44 0x00>;                 //1.8V LDO enable
		avdd-supply = <&pm8998_l28>;			//3.3V power regulator
		//pinctrl-names = "pmx_ts_active", "pmx_ts_suspend";
		//pinctrl-0 = <&ts_active>;
		//pinctrl-1 = <&ts_int_suspend &ts_reset_suspend>;
		st,irq-gpio = <&tlmm 125 0x00>;		//interrupt gpio
		st,reset-gpio = <&tlmm 99 0x00>;	//specify the gpio which control the reset pin of the IC (if available, not mandatory)
		//st,regulator_dvdd = "vdd";
		st,regulator_avdd = "avdd";
	};


};
